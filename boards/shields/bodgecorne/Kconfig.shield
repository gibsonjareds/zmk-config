## boards/shields/bodgecorne/Kconfig.shield
```kconfig
# Copyright (c) 2020 Pete Johanson
# SPDX-License-Identifier: MIT

config SHIELD_BODGECORNE_LEFT
	def_bool $(shields_list_contains,bodgecorne_left)

config SHIELD_BODGECORNE_RIGHT
	def_bool $(shields_list_contains,bodgecorne_right)
```
